## sdkconfig.defaults
```kconfig
# ---- 目标与 Flash（N16R8）----
CONFIG_IDF_TARGET="esp32s3"
CONFIG_ESPTOOLPY_FLASHSIZE_16MB=y
CONFIG_ESPTOOLPY_FLASHMODE_DIO=y
CONFIG_ESPTOOLPY_FLASHFREQ_80M=y

# ---- PSRAM：片内 8MB OPI(octal)，选错认不到 ----
CONFIG_SPIRAM=y
CONFIG_SPIRAM_MODE_OCT=y
CONFIG_SPIRAM_SPEED_80M=y
CONFIG_SPIRAM_FETCH_INSTRUCTIONS=y
CONFIG_SPIRAM_RODATA=y
CONFIG_SPIRAM_USE_MALLOC=y
CONFIG_SPIRAM_MALLOC_ALWAYSINTERNAL=4096

# ---- 日志走内置 USB-Serial/JTAG ----
CONFIG_ESP_CONSOLE_USB_SERIAL_JTAG=y

# ---- 分区表 ----
CONFIG_PARTITION_TABLE_CUSTOM=y
CONFIG_PARTITION_TABLE_CUSTOM_FILENAME="partitions.csv"

# ---- CPU / 主任务 ----
CONFIG_ESP_DEFAULT_CPU_FREQ_MHZ_240=y
CONFIG_ESP_MAIN_TASK_STACK_SIZE=6144
CONFIG_FREERTOS_HZ=1000

# ---- 网络：HTTP 拉流 + HTTPS OTA ----
CONFIG_LWIP_MAX_SOCKETS=10
CONFIG_ESP_HTTP_CLIENT_ENABLE_HTTPS=y
CONFIG_MBEDTLS_CERTIFICATE_BUNDLE=y
CONFIG_MBEDTLS_CERTIFICATE_BUNDLE_DEFAULT_FULL=y
CONFIG_HTTPD_MAX_REQ_HDR_LEN=1024

# ---- Wi-Fi 缓冲：拉流要稳 ----
CONFIG_ESP_WIFI_STATIC_RX_BUFFER_NUM=16
CONFIG_ESP_WIFI_DYNAMIC_RX_BUFFER_NUM=64
CONFIG_ESP_WIFI_DYNAMIC_TX_BUFFER_NUM=64
CONFIG_ESP_WIFI_AMPDU_RX_ENABLED=y
CONFIG_ESP_WIFI_RX_BA_WIN=16

# ---- LVGL 8.4 ----
CONFIG_LV_COLOR_DEPTH_16=y
CONFIG_LV_COLOR_16_SWAP=y
CONFIG_LV_MEM_CUSTOM=y
CONFIG_LV_USE_PERF_MONITOR=n
# Montserrat 只用它自带的图标字形（喇叭 / Wi-Fi / 播放键），中文走自建 CJK 字库
CONFIG_LV_FONT_MONTSERRAT_14=y
CONFIG_LV_FONT_MONTSERRAT_12=y
CONFIG_LV_FONT_MONTSERRAT_18=y
CONFIG_LV_FONT_MONTSERRAT_20=y
CONFIG_BOOTLOADER_APP_ROLLBACK_ENABLE=y
CONFIG_LV_USE_LOG=n

# ---- 编解码器：只编入本板实际有的 ES8311 ----
CONFIG_CODEC_ES8311_SUPPORT=y

# ---- 编译优化：字库大，优化尺寸 ----
CONFIG_COMPILER_OPTIMIZATION_SIZE=y
```
